## drivers/input/touchscreen/xiaomi/Kconfig
```kconfig
config TOUCHSCREEN_XIAOMI_TOUCHFEATURE
	tristate "Xiaomi Touch Feature"
	depends on INPUT_TOUCHSCREEN
	help
	  Say Y here if you enable xiaomi touch feature.

	  If unsure, say N.

	  To compile this driver as a module, choose M here:

config BUMP_SAMPLE_RATE
	tristate "Bump Sample Rate"
	depends on TOUCHSCREEN_XIAOMI_TOUCHFEATURE
	help
	  Say Y here if you enable xiaomi boost touch feature.

	  If unsure, say N.

	  To compile this driver as a module, choose M here:
```

## kernel/sched/cpufreq_effiency/Kconfig
```kconfig
config OPLUS_FEATURE_SUGOV_POWER_EFFIENCY
	tristate "power domain effiency"
	default y
	help
	     Select Left or right frequence point as target frequence base on powerdomain and currenct frequence value

config OPLUS_UAG_AMU_AWARE
	bool "consider amu info for cpufreq decision"
	default y
	help
	  Consider AMU info such as cycles/stall ... to adjust cpufreq.

config OPLUS_FEATURE_OCH
	tristate "cpufreq_health"
	default y
	help
		This selects cpufreq and vlotage statistics driver

config UAG_NONLINEAR_FREQ_CTL
	bool "Non-linear frequency control"
	default n
	help
	  Choose this option to enable non-linear frequency control.
	  This will change per-opp capacity from linear scaled by
	  freuqency to evaluated by benchmark. This makes capacity
	  more accurate and will let scheduler/schedutil use more
	  suitable frequency.

config OPLUS_UAG_USE_TL
	bool "use target loads in uag cpufreq policy governor"
	default y
	help
	  Add target_loads sysfs attr in uag cpufreq policy governor.

config OPLUS_MULTI_LV_TL
	bool "Add multi-level target loads to scale cpu frequency"
	default n
	help
	  Add multi-level target loads to scale cpu frequency.
```
